## Kconfig
```kconfig
menu "Badge.Team BSP"
	choice
		prompt "Board"
		default BSP_TARGET_TANMATSU

		config BSP_TARGET_STUB
			bool "Generic (stub)"

		config BSP_TARGET_ESP32_P4_FUNCTION_EV_BOARD
			bool "Espressif ESP32-P4 Function EV Board"

		config BSP_TARGET_ESP32_S31_KORVO_1
			bool "Espressif ESP32-S31 Korvo 1"

		config BSP_TARGET_TANMATSU
			bool "Nicolai Electronics Tanmatsu"

		config BSP_TARGET_KAMI
			bool "Nicolai Electronics Kami"

		config BSP_TARGET_MCH2022
			bool "Badge.Team MCH2022 badge"

		config BSP_TARGET_HACKERHOTEL_2024
			bool "Badge.Team Hackerhotel 2024 badge"

		config BSP_TARGET_BORNHACK_2024_POV
			bool "Bornhack 2024 POV"

		config BSP_TARGET_BORNHACK_2025_CIRCLE
			bool "Bornhack 2025 circle"

		config BSP_TARGET_HACKADAY2025
			bool "Hackaday 2025 Communicator badge"
 
		config BSP_TARGET_HELTECV3
			bool "Heltec v3"

		config BSP_TARGET_WHY2025
			bool "WHY2025 badge"

	endchoice

	config BSP_RESERVE_RTC_RETAIN_MEM
		bool
		default y
		select BOOTLOADER_CUSTOM_RESERVE_RTC
		help
			bsp_device_restart_to_launcher() (implemented as a weak
			fallback in stub/badge_bsp_device.c and always linked into
			every target because bsp_stub is unconditionally added to
			the component) calls bootloader_common_get_rtc_retain_mem()
			from bootloader_support. That function is only declared when
			CONFIG_BOOTLOADER_CUSTOM_RESERVE_RTC is enabled, and the
			underlying CONFIG_BOOTLOADER_RESERVE_RTC_MEM symbol it
			selects has no prompt, so it cannot be set directly from a
			downstream project's sdkconfig.defaults. Select it here
			instead of requiring every consumer to discover this.
endmenu
```
